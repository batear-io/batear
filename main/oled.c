/*
 * oled.c — Minimal SSD1306 128x64 I2C OLED driver
 *
 * Uses ESP-IDF i2c_master driver. Frame-buffered: call oled_print()
 * then oled_flush() to update the display.
 */

#include "oled.h"
#include <string.h>
#include "driver/i2c_master.h"
#include "driver/gpio.h"
#include "esp_log.h"
#include "freertos/FreeRTOS.h"
#include "freertos/task.h"

#define SSD1306_ADDR    0x3C
#define WIDTH           128
#define HEIGHT          64
#define PAGES           (HEIGHT / 8)
#define FB_SIZE         (WIDTH * PAGES)

static const char *TAG = "oled";
static i2c_master_dev_handle_t s_dev;
static uint8_t s_fb[FB_SIZE];

/* 5x7 font, ASCII 32–126. Each char = 5 column bytes, LSB = top pixel. */
static const uint8_t font5x7[][5] = {
    {0x00,0x00,0x00,0x00,0x00}, /* 32 (space) */
    {0x00,0x00,0x5F,0x00,0x00}, /* 33 ! */
    {0x00,0x07,0x00,0x07,0x00}, /* 34 " */
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    {0x10,0x08,0x08,0x10,0x08}, /*126 ~ */
};

static void ssd1306_cmd(uint8_t cmd)
{
    uint8_t buf[2] = { 0x00, cmd };
    i2c_master_transmit(s_dev, buf, 2, 100);
}

esp_err_t oled_init(int sda_gpio, int scl_gpio, int rst_gpio, bool flip)
{
    /* Hardware reset */
    gpio_config_t rst_cfg = {
        .pin_bit_mask = (1ULL << rst_gpio),
        .mode         = GPIO_MODE_OUTPUT,
        .pull_up_en   = GPIO_PULLUP_DISABLE,
        .pull_down_en = GPIO_PULLDOWN_DISABLE,
        .intr_type    = GPIO_INTR_DISABLE,
    };
    gpio_config(&rst_cfg);
    gpio_set_level((gpio_num_t)rst_gpio, 0);
    vTaskDelay(pdMS_TO_TICKS(10));
    gpio_set_level((gpio_num_t)rst_gpio, 1);
    vTaskDelay(pdMS_TO_TICKS(10));

    /* I2C bus */
    i2c_master_bus_config_t bus_cfg = {};
    bus_cfg.i2c_port    = I2C_NUM_0;
    bus_cfg.sda_io_num  = (gpio_num_t)sda_gpio;
    bus_cfg.scl_io_num  = (gpio_num_t)scl_gpio;
    bus_cfg.clk_source  = I2C_CLK_SRC_DEFAULT;
    bus_cfg.glitch_ignore_cnt = 7;
    bus_cfg.flags.enable_internal_pullup = true;

    i2c_master_bus_handle_t bus;
    esp_err_t err = i2c_new_master_bus(&bus_cfg, &bus);
    if (err != ESP_OK) {
        ESP_LOGE(TAG, "i2c_new_master_bus: %s", esp_err_to_name(err));
        return err;
    }

    i2c_device_config_t dev_cfg = {};
    dev_cfg.dev_addr_length = I2C_ADDR_BIT_LEN_7;
    dev_cfg.device_address  = SSD1306_ADDR;
    dev_cfg.scl_speed_hz    = 400000;

    err = i2c_master_bus_add_device(bus, &dev_cfg, &s_dev);
    if (err != ESP_OK) {
        ESP_LOGE(TAG, "i2c_master_bus_add_device: %s", esp_err_to_name(err));
        return err;
    }

    /* SSD1306 init sequence. Orientation is set by segment remap (A0/A1)
     * and COM scan direction (C0/C8); flipping both rotates 180°. */
    const uint8_t init_cmds[] = {
        0xAE,       /* display off */
        0xD5, 0x80, /* clock div */
        0xA8, 0x3F, /* mux ratio 64 */
        0xD3, 0x00, /* display offset 0 */
        0x40,       /* start line 0 */
        0x8D, 0x14, /* charge pump enable */
        0x20, 0x00, /* horizontal addressing mode */
        flip ? 0xA1 : 0xA0,   /* segment remap   */
        flip ? 0xC8 : 0xC0,   /* COM scan direction */
        0xDA, 0x12, /* COM pins */
        0x81, 0xCF, /* contrast */
        0xD9, 0xF1, /* pre-charge */
        0xDB, 0x40, /* VCOMH deselect */
        0xA4,       /* display from RAM */
        0xA6,       /* normal display */
        0xAF,       /* display on */
    };
    for (size_t i = 0; i < sizeof(init_cmds); i++) {
        ssd1306_cmd(init_cmds[i]);
    }

    oled_clear();
    oled_flush();
    ESP_LOGI(TAG, "SSD1306 128x64 ready%s", flip ? " (flipped)" : "");
    return ESP_OK;
}

void oled_clear(void)
{
    memset(s_fb, 0, FB_SIZE);
}

void oled_print(int col, int row, const char *text)
{
    if (row < 0 || row >= PAGES) return;
    int x = col * 6;
    for (const char *p = text; *p && x < WIDTH - 5; p++) {
        int idx = *p - 32;
        if (idx < 0 || idx >= (int)(sizeof(font5x7) / sizeof(font5x7[0])))
            idx = 0;
        for (int c = 0; c < 5; c++) {
            s_fb[row * WIDTH + x] = font5x7[idx][c];
            x++;
        }
        s_fb[row * WIDTH + x] = 0x00; /* 1-pixel gap */
        x++;
    }
}

void oled_flush(void)
{
    ssd1306_cmd(0x21); ssd1306_cmd(0); ssd1306_cmd(127); /* col range */
    ssd1306_cmd(0x22); ssd1306_cmd(0); ssd1306_cmd(7);   /* page range */

    /* Send framebuffer in chunks (I2C max transaction varies) */
    for (int page = 0; page < PAGES; page++) {
        uint8_t buf[WIDTH + 1];
        buf[0] = 0x40; /* data mode */
        memcpy(buf + 1, &s_fb[page * WIDTH], WIDTH);
        i2c_master_transmit(s_dev, buf, sizeof(buf), 100);
    }
}
