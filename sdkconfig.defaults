## sdkconfig.defaults
```kconfig
# 240 MHz for FFT processing and logging
CONFIG_ESP_DEFAULT_CPU_FREQ_MHZ_240=y

# Serial logging
CONFIG_ESP_CONSOLE_UART_DEFAULT=y
CONFIG_LOG_DEFAULT_LEVEL_INFO=y

# Increase FreeRTOS tick rate so pdMS_TO_TICKS() is accurate to 1 ms.
CONFIG_FREERTOS_HZ=1000

# Task stack sizes
CONFIG_ESP_MAIN_TASK_STACK_SIZE=4096
```
